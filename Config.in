## Config.in
```kconfig
################################################################################
# SPDX-License-Identifier: LGPL-3.0-only
#
# This file is part of hed.
################################################################################

config HED_ASSERT_API
	bool "API assertion"
	default n
	help
	  Build hed library with high-level API assertions enabled to ensure
	  that API functions exposed by Utils will perform full verification of
	  arguments consistency.

config HED_ASSERT_INTERN
	bool "Internal assertion"
	select HED_ASSERT_API
	default n
	help
	  Build hed library with internal assertions enabled.

config BASE_ASSERT
	bool
	default HED_ASSERT_API

config INET_ASSERT
	bool
	default HED_ASSERT_API

menuconfig HED_TROER
	bool "Build hed-troer library"
	default y
	help
	  Build hed serialisable library usable with troer.

config HED_TROER_BASE
	bool "Base library"
	default y
	depends on HED_TROER
	help
	  Build hed serialisable library usable with troer.

config HED_TROER_INET
	bool "Inet library"
	default y
	depends on HED_TROER
	help
	  Build hed serialisable library usable with troer.
```
